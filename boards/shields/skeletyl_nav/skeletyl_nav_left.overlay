#include "skeletyl_nav.dtsi"

&kscan {
    col-gpios
            = <&pro_micro 18 (GPIO_ACTIVE_HIGH | GPIO_PULL_DOWN)> // silkscreen 115 
            , <&pro_micro 15 (GPIO_ACTIVE_HIGH | GPIO_PULL_DOWN)> // silkscreen 113 
            , <&pro_micro 14 (GPIO_ACTIVE_HIGH | GPIO_PULL_DOWN)> // silkscreen 111 
            , <&pro_micro 16 (GPIO_ACTIVE_HIGH | GPIO_PULL_DOWN)> // silkscreen 010 
            , <&pro_micro 10 (GPIO_ACTIVE_HIGH | GPIO_PULL_DOWN)> // silkscreen 009 
            ;
        row-gpios
            = <&pro_micro 5 GPIO_ACTIVE_HIGH> // R0, silkscreen 024 
            , <&pro_micro 6 GPIO_ACTIVE_HIGH> // R1, silkscreen 100 
            , <&pro_micro 7 GPIO_ACTIVE_HIGH> // R2, silkscreen 011 
            , <&pro_micro 8 GPIO_ACTIVE_HIGH> // R3, silkscreen 104 
            , <&pro_micro 9 GPIO_ACTIVE_HIGH> // R4, silkscreen 106  5way's GND
            ;
};
