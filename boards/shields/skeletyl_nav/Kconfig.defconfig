## boards/shields/skeletyl_nav/Kconfig.defconfig
```kconfig
if SHIELD_SKELETYL_NAV_LEFT

config ZMK_KEYBOARD_NAME
    default "Skeletyl-nav"

config ZMK_SPLIT_ROLE_CENTRAL
    default y

endif # SHIELD_SKELETYL_NAV_LEFT

if SHIELD_SKELETYL_NAV_LEFT || SHIELD_SKELETYL_NAV_RIGHT

config ZMK_SPLIT
    default y

endif # SHIELD_SKELETYL_NAV_LEFT || SHIELD_SKELETYL_NAV_RIGHT
```

## boards/shields/skeletyl_nav/Kconfig.shield
```kconfig
config SHIELD_SKELETYL_NAV_LEFT
    def_bool $(shields_list_contains,skeletyl_nav_left)

config SHIELD_SKELETYL_NAV_RIGHT
    def_bool $(shields_list_contains,skeletyl_nav_right)
```
