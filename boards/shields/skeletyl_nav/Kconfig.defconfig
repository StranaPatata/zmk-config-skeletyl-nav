## boards/shields/skeletyl_nav/Kconfig.defconfig
```kconfig
if SHIELD_SKELETYL_NAV_LEFT

config ZMK_KEYBOARD_NAME
    default "Skeletyl-nav"

config ZMK_SPLIT_ROLE_CENTRAL
    default y

endif # SHIELD_SKELETYL_NAV_LEFT

if SHIELD_SKELETYL_NAV_LEFT || SHIELD_SKELETYL_NAV_RIGHT

config ZMK_SPLIT
    default y

endif # SHIELD_SKELETYL_NAV_LEFT || SHIELD_SKELETYL_NAV_RIGHT


if SHIELD_SKELETYL_NAV_DONGLE

config ZMK_KEYBOARD_NAME
    default "Skeletyl-Dongle"

config ZMK_SPLIT_ROLE_CENTRAL
    default y

config ZMK_SPLIT
    default y

# Two split peripherals: left and right halves
config ZMK_SPLIT_BLE_CENTRAL_PERIPHERALS
    default 2

# Two halves + five host Bluetooth profiles
config BT_MAX_CONN
    default 7

config BT_MAX_PAIRED
    default 7
 
endif # SHIELD_SKELETYL_NAV_DONGLE
```

## boards/shields/skeletyl_nav/Kconfig.shield
```kconfig
config SHIELD_SKELETYL_NAV_LEFT
    def_bool $(shields_list_contains,skeletyl_nav_left)

config SHIELD_SKELETYL_NAV_RIGHT
    def_bool $(shields_list_contains,skeletyl_nav_right)

config SHIELD_SKELETYL_NAV_DONGLE
    def_bool $(shields_list_contains,skeletyl_nav_dongle)
```

## config/west.yml
```yaml
manifest:
  defaults:
    revision: v0.3
  remotes:
    - name: zmkfirmware
      url-base: https://github.com/zmkfirmware
    # zmk locale
    - name: joelspadin
      url-base: https://github.com/joelspadin
   # dongle screen
    - name: englmaxi
      url-base: https://github.com/englmaxi
    # Additional modules containing boards/shields/custom code can be listed here as well
    # See https://docs.zephyrproject.org/3.2.0/develop/west/manifest.html#projects
  projects:
    - name: zmk
      remote: zmkfirmware
      import: app/west.yml
    - name: zmk-locales
      remote: joelspadin
      revision: main
    - name: zmk-dongle-display
      remote: englmaxi
      revision: v0.3 # use 'v0.3' instead of 'main' if you use have pinned zmk to 'v0.3' or below, "main" for else
  self:
    path: config
```
